/dts-v1/;
/plugin/;

&{/} {
	n1: node1 {
		p1;
		p2 = <&ext1>;
		p3 = <0xaa>;
		phandle = <0x01>;

		n2: node2 {
			p1 = <0xaa>;
			p2 = <&n1>;
			p3 = <0xaa &ext2>;
			phandle = <0x02>;
		};

		n3: node3 {
			p1 = <&ext2>;
			p2 = <&n2>;
			phandle = <0x03>;
		};
	};
};
