/dts-v1/;
/plugin/;

&{/} {
	n1:node1 {
		p1;
		p2 = <&n2>;
		p3 = <0xaa>;
		phandle = <0x02>;

		n2:node2 {
			p1 = <0xaa>;
			p2 = <&n1>;
			p3 = <&n3>;
			phandle = <0x01>;
		};

		n3:node3 {
			p1 = <&n2>;
			phandle = <0x03>;
		};
	};
};
